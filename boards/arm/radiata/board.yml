## boards/arm/radiata/board.yml
```yaml
boards:
  - name: radiata_left
    vendor: homerow
    socs:
      - name: nrf52840
        variants:
          - name: zmk
  - name: radiata_right
    vendor: homerow
    socs:
      - name: nrf52840
        variants:
          - name: zmk
```
