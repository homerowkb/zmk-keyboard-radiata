## boards/homerow/radiata/board.yml
```yaml
boards:
  - name: radiata_left
    vendor: homerow
    socs:
      - name: nrf52840
  - name: radiata_right
    vendor: homerow
    socs:
      - name: nrf52840
```
